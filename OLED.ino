void oled_showIP() {
  oled.clear(ALL); // Clear the display's internal memory
  oled.clear(PAGE); // Clear the buffer.
  oled.setFontType(0);
  oled.setCursor(0, 0);
  String str = "";
  for (int i = 0; i < 4; i++)
    str += i  ? "." + String(WiFi.localIP()[i]) : String(WiFi.localIP()[i]);
  str += ":";
  str += localPort;
  oled.print(str);
  oled.setCursor(0, 20);
  oled.print(String(DeviceName) + ".local");
  oled.display();
  delay(5000);
}

void routePixel(OSCMessage &msg, int addrOffset ) {
  Serial.println("pixel");
  drawPixel(msg.getInt(0), msg.getInt(1), msg.getInt(2) == 1);
}

void drawPixel(int x_, int y_, boolean color) {
  int x =  x_;
  int y = y_;
  bool BW = color;
  if (BW) {
    oled.pixel(x, y);
  }
  else {
    oled.pixel(x, y, BLACK, NORM);
  }
  oled.display();
  delay(10);
}

void routeFlip(OSCMessage &msg, int addrOffset ) {
  Serial.println("Clear");
  int xflip =   msg.getInt(0);
  int yflip = msg.getInt(1);
  flipScreen(xflip == 1, yflip == 1);
}

void flipScreen(bool H, bool V) {
  oled.flipVertical(H);
  oled.flipHorizontal(V);
  oled.display();
  delay(10);
}

void routeClear(OSCMessage &msg, int addrOffset ) {
  Serial.println("Clear");
  oled.clear(PAGE);     // Clear the screen
  oled.display();
  delay(10);
}

void routeLine(OSCMessage &msg, int addrOffset ) {
  drawLineAt(msg.getInt(0),   msg.getInt(1), msg.getInt(2), msg.getInt(3), msg.getInt(4) == 1  );
}

void drawLineAt(int x1_, int y1_, int x2_, int y2_, bool c_) {

  Serial.println("Line");
  int x1 =   x1_;
  int y1 = y1_;
  int x2 =   x2_;
  int y2 = y2_;
  bool BW = c_;
  if (BW) {
    oled.line(x1, y1, x2, y2);
  }
  else {
    oled.line(x1, y1, x2, y2, BLACK, NORM);
  }
  oled.display();
  delay(10);

}

void routeInvert(OSCMessage &msg, int addrOffset ) {
  Serial.println("Invert");
  int setTo =   msg.getInt(0);
  if (setTo == 0) {
    oled.invert(true);
  } else {
    oled.invert(false);
  }
  oled.display();
  delay(10);
}

void routeScroll(OSCMessage &msg, int addrOffset ) {
  Serial.println("Scroll");

  int startI =  msg.getInt(0);
  int stopI =  msg.getInt(1);

  oled.scrollRight(startI, stopI);
}

void routeScrollStop(OSCMessage &msg, int addrOffset ) {
  Serial.println("Scroll Stop");
  oled.scrollStop();
}

void routeRect(OSCMessage &msg, int addrOffset ) {
  drawRectAt(msg.getInt(0), msg.getInt(1),  msg.getInt(2), msg.getInt(3), msg.getInt(4) == 1,  msg.getInt(5) == 1   );
}

void drawRectAt(int XX_, int YY_, int WW_, int  HH_, bool c_, bool filled_) {
  Serial.println("Rect");
  int x =   XX_;
  int y = YY_;
  int w =  WW_;
  int h = HH_;
  bool BW = c_;
  bool filled = filled_;
  if (filled) {
    if (BW) {
      oled.rectFill(x, y, w, h);
    }
    else {
      oled.rectFill(x, y, w, h, BLACK, NORM);
    }
  } else {
    if (BW) {
      oled.rect(x, y, w, h);
    }
    else {
      oled.rect(x, y, w, h, BLACK, NORM);
    }
  }
  oled.display();
  delay(10);
}

void routeCircle(OSCMessage &msg, int addrOffset ) {
  Serial.println("Circle");
  int x =   msg.getInt(0);
  int y = msg.getInt(1);
  int radius =   msg.getInt(2);
  bool BW = msg.getInt(3) == 1;
  bool filled = msg.getInt(4) == 1;
  if (filled) {
    if (BW) {
      oled.circleFill(x, y, radius);
    }
    else {
      oled.circleFill(x, y, radius, BLACK, NORM);
    }
  } else {
    if (BW) {
      oled.circle(x, y, radius);
    }
    else {
      oled.circle(x, y, radius, BLACK, NORM);
    }
  }
  oled.display();
  delay(10);
}

void routeText(OSCMessage &msg, int addrOffset ) {
  Serial.println("Text");
  // font 0. 5x8
  // font 1. 8x16.
  // font 2. 10x16.
  // font 3. 12x48.
  // font 4. 31x48.

  int x =   msg.getInt(1);
  int y = msg.getInt(2);
  int font = msg.getInt(3);


  int lengthStr = msg.getDataLength(0);
  char strIn[lengthStr];
  msg.getString(0, strIn, lengthStr);


  Serial.println("---");
  Serial.println( oled.getTotalFonts() );
  Serial.println(strIn);
  Serial.println(font);
  oled.setFontType(font);

  // oled.setFontType(1);  // Use the biggest font
  delay(10);
  oled.setCursor(x, y);
  oled.print(strIn);
  oled.display();
  delay(10);

}

void routeCountdown(OSCMessage &msg, int addrOffset ) {
  Serial.println("countdown");
  doCountdown(msg.getInt(0));

}

void doCountdown(int secondsTo) {
  oled.setFontType(3);  // Use the biggest font
  int ms = 0;
  int s = secondsTo;
  while (s >= 0 )
  {
    oled.clear(PAGE);     // Clear the display
    oled.setCursor(0, 0); // Set cursor to top-left
    if (s < 10)
      oled.print("00");   // Print "00" if s is 1 digit
    else if (s < 100)
      oled.print("0");    // Print "0" if s is 2 digits
    oled.print(s);        // Print s's value
    oled.print(":");      // Print ":"
    oled.print(ms);       // Print ms value
    oled.display();       // Draw on the screen
    ms--;         // Increment ms
    if (ms < 0) // If ms is >= 10
    {
      ms = 10;     // Set ms back to 0
      s--;        // and increment s
      ESP.wdtFeed();
    }
  }

  oled.invert(true);
  SS4();
  delay(250);
  oled.invert(false);
  SS4();
  delay(250);
  oled.invert(true);
  SS4();
  delay(250);
  oled.invert(false);
  SS4();
  delay(250);
  oled.invert(true);
  SS4();
  delay(250);
  oled.invert(false);
  SS4();
  delay(250);
}

void printTitle(String title, int font) {
  int middleX = oled.getLCDWidth() / 2;
  int middleY = oled.getLCDHeight() / 2;
  oled.clear(PAGE);
  oled.setFontType(font);
  // Try to set the cursor in the middle of the screen
  oled.setCursor(middleX - (oled.getFontWidth() * (title.length() / 2)), middleY - (oled.getFontWidth() / 2));
  oled.print(title);  // Print the title:
  oled.display();
  delay(1500);
  oled.clear(PAGE);
}


void printText(String text, int font)
{
  oled.clear(PAGE);
  oled.setFontType(font);
  oled.setCursor(0, 0);
  // Print the title:
  oled.print(text);
  oled.display();
  delay(1500);
  oled.clear(PAGE);
}



void slowText(String text) {
  oled.clear(PAGE);     // Clear the screen
  oled.setFontType(0);  // Set font to type 0
  oled.setCursor(0, 0); // Set cursor to top-left

  for (int i = 0; i <= text.length(); i++)
  {
    // You can write byte values and they'll be mapped to
    // their ASCII equivalent character.
    oled.print(text[i]);  // Write a byte out as a character
    oled.display(); // Draw on the screen
    delay(10);      // Wait 10ms
    // We can only display 60 font 0 characters at a time.
    // Every 60 characters, pause for a moment. Then clear the page and start over.
    if ((i % 60 == 0) && (i != 0))
    {
      delay(500);           // Delay 500 ms
      oled.clear(PAGE);     // Clear the page
      oled.setCursor(0, 0); // Set cursor to top-left
    }
  }
}


uint8_t bender [] = {
  0xFF, 0xFF, 0xFF, 0xFF, 0xFF, 0xFF, 0xFF, 0xFF, 0xFF, 0x7F, 0xBF, 0xDF, 0x5F, 0x5F, 0x5F, 0x5F,
  0x5F, 0x5F, 0x5F, 0x5F, 0x5F, 0x5F, 0x5F, 0x5F, 0x5F, 0x5F, 0x5F, 0x5F, 0x5F, 0x5F, 0x5F, 0x5F,
  0x5F, 0x5F, 0x5F, 0x5F, 0x5F, 0x5F, 0x5F, 0x5F, 0x5F, 0x5F, 0x5F, 0x5F, 0x5F, 0x5F, 0x5F, 0x5F,
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  0xFF, 0xFF, 0xFF, 0xFF, 0xFF, 0xFF, 0xFF, 0xFF, 0xFF, 0xFF, 0xFF, 0xFF, 0xFF, 0xFF, 0xFF, 0xFF
};

uint8_t heart [] =
{
  0x00, 0x00, 0x00, 0x00, 0x00, 0x00, 0x00, 0x00, 0x00, 0x00,
  0x00, 0x00, 0x00, 0x80, 0x80, 0xC0, 0xC0, 0xC0, 0xE0, 0xE0,
  0xE0, 0xE0, 0xE0, 0xE0, 0xC0, 0xC0, 0x80, 0x80, 0x00, 0x00,
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  0x00, 0x00, 0x00, 0x00
};

uint8_t balloon [] =
{
  0x00, 0x00, 0x00, 0x00, 0x00, 0x00, 0x00, 0x00, 0x00, 0x00,
  0x00, 0x00, 0x00, 0x00, 0x00, 0x00, 0x00, 0x00, 0x00, 0x00,
  0x00, 0x00, 0x80, 0xC0, 0xF0, 0xF8, 0xF8, 0xFC, 0xFC, 0xFE,
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  0x00, 0x00, 0x00, 0x00
};

uint8_t cat [] {

  0xE0, 0xF0, 0x30, 0xF0, 0x00, 0xA0, 0xF0, 0x70, 0xF0, 0xF8,
  0xF0, 0xF0, 0xFA, 0x1B, 0xC1, 0xE3, 0x23, 0x03, 0x07, 0x0F,
  0x0F, 0x16, 0x3E, 0xF4, 0xE0, 0xC8, 0xF6, 0xFE, 0xFF, 0x3C,
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  0x03, 0x23, 0x20, 0x00
};

uint8_t moon [] {
  0xFF, 0xFF, 0xFF, 0xFF, 0xFF, 0xFF, 0xFF, 0xFF, 0xFF, 0xFF,
  0xFF, 0xFF, 0xFF, 0xFF, 0xFF, 0xFF, 0xFF, 0xFF, 0x7F, 0x7F,
  0x3F, 0x9F, 0x8F, 0xCF, 0xCF, 0xE7, 0xE7, 0xE7, 0xF3, 0xF3,
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  0xFF, 0xFF, 0xFF, 0xFF
};

void routePictureCall(int index) {
  switch (index) {
    case 1:
      drawBalloon();
      break;
    case 2:
      drawBender();
      break;
    case 3:
      drawHeart();
      break;
    case 4:
      drawCat();
      break;
  }
}

void routeBalloon(OSCMessage & msg, int addrOffset ) {
  drawBalloon();
}

void drawBalloon() {
  oled.clear(PAGE);//clear the screen before we draw our image
  oled.drawBitmap(balloon);//call the drawBitmap function and pass it the array from above
  oled.display();//display the imgae
}

void routeBender(OSCMessage & msg, int addrOffset ) {
  drawBender();
}

void drawBender() {
  oled.clear(PAGE);//clear the screen before we draw our image
  oled.drawBitmap(bender);//call the drawBitmap function and pass it the array from above
  oled.display();//display the imgae
}

void routeHeart(OSCMessage & msg, int addrOffset ) {
  drawHeart();
}

void drawHeart() {
  oled.clear(PAGE);//clear the screen before we draw our image
  oled.drawBitmap(heart);//call the drawBitmap function and pass it the array from above
  oled.display();//display the imgae
}


void routeCat(OSCMessage & msg, int addrOffset ) {
  drawCat();
}

void drawCat() {
  oled.clear(PAGE);//clear the screen before we draw our image
  oled.drawBitmap(cat);//call the drawBitmap function and pass it the array from above
  oled.display();//display the imgae
}


void drawMoon() {
  oled.clear(PAGE);//clear the screen before we draw our image
  oled.drawBitmap(moon);//call the drawBitmap function and pass it the array from above
  oled.display();//display the imgae
}

